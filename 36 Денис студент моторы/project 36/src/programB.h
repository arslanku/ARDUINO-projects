#include <Arduino.h>

#include <EEPROM.h> //библиотека для работы с энергонезависимой памятью ардуино
#define sensor A0   // датчик давления на пин A0

#define IN 4        // управление направлением вращения мотора для драйвера типа L298n
#define PWM 5       // управление направлением вращения мотора для драйвера типа L298n

unsigned long timer;  // переменная таймера 1 счетчика времени
unsigned long timer2; // переменная таймера 2 работы мотора
unsigned long timer3; // переменная таймера 3 цикла записи в память

word Add1 = 0;        // переменная для адреса ячейки памяти показаний датчика давления (запись происходит на 2 ячейки памяти для 2-х байтового числа начиная с 0000)
word Add2 = 2;        // переменная для отметки времени (запись происходит на 2 ячейки памяти для 2-х байтового числа начиная с 0002)
word sens;            // переменная для записи значений датчика в память ардуино
word normal = 500;    // значение нормального давления датчика, установить от 150 до 873
word normalmax;       // переменная для вычисления значения максимального давления от нормального
word normalmin;       // переменная для вычисления значения минимального давления от нормального
byte vpered = 0;      // направление вращения мотора: 0 - вперед, 1 - назад
byte nazad = 1;       // направление вращения мотора: 1 - вперед, 0 - назад
word t = 0;           // переменная времени для записи в память 2 байта
word mm = 0;          // переменная значения минут
word ss = 0;          // переменная значения секунд
word hh = 0;          // переменная значения часов
byte F;               // флаг для выполнения одного цикла чтения всех данных из памяти устройства

void setup()
{
    Serial.begin(9600);       // скорость обмена данными с пк
    pinMode(sensor, INPUT);   // установка пина sensor как вход
    pinMode(IN, OUTPUT);      // установка пин 4 как выход
    pinMode(PWM, OUTPUT);     // установка пин 5 как выход
    normalmax = normal + 150; // значениедавления, при котором включается мотор и загорается красный светодиод
    normalmin = normal - 150; // значение при котором загорается зеленый светодиод
    delay(1000);              // пауза для подачи питания на датчик и установления истинного значения

    // выполняем первый цикл записи параметров датчика и времени в память ардуино Ппри первом включении
    analogRead(sensor);     // считываем показания датчика на пине А0
    sens = sensor;          // присваиваем значение датчика переменной sens для дальнейшего сохранения в память устройства
    EEPROM.put(Add1, sens); // записываем значение давления в 1 и 2 ячейки (по адресу 0 и 1) памяти устройства
    EEPROM.put(Add2, t);    // записываем значение времени в 3 и 4 ячейки (по адресу 2 и 3) памяти устройства
    F = 0;
}

void loop()
{
    // 1 рав выполняем чтение данных времени и давления из памяти устройства и выводим их в монитор порта

    if (F == 0)
    {                                         // флаг для однократного чтения данных из устройства
        Serial.println("chtenie dannih...."); // выводим сообщение в монитор порта о начале чтения данных из памяти устройства
        t = EEPROM.get(Add2, t);              // считываем данные времени из ячейки памяти устройства по адресу Add2
        sens = EEPROM.get(Add1, sens);        // считываем данные давления из ячейки памяти устройства по адресу Add1
        Serial.println(t);                    // выводим полученные значения в монитор порта "время"-"давление"
        Serial.println(sens);
        Add1 = Add1 + 4; // переходим к следующей ячейке памяти для значений давления
        Add2 = Add2 + 4; // переходим к следующей ячейке памяти для значений времени
        if (Add1 > 1020 || Add2 > 1022)
        {                                                // при переходе к последней ячейке памяти устройства
            Serial.println("konec chteniya dannih...."); // выводим сообщение об окончании чтения данных из устройства
            Add1 = 0;                                    // присваиваем первоначальные значения адресу устройства для последующего цикла записи
            Add2 = 2;                                    // присваиваем первоначальные значения адресу устройства для последующего цикла записи
            F = 1;
        } // флаг для недопущения повторного запуска цикла чтения данных из памяти устройтсва
    }

    // создаем функцию формирования времени в виде 5 значного числа в формате hmmss
    if (millis() - timer >= 1000)
    {
        timer = millis();
        ss = ss + 1;
        if (ss >= 60)
        {
            ss = 0;
            mm = mm + 100;
        }
        if (mm >= 6000)
        {
            mm = 0;
            hh = hh + 10000;
        }
        if (hh >= 60000)
        {
            hh = 0;
        }
        t = hh + mm + ss; // время сохраняется и выводится в виде пятизначного числа hmmss (число word 2 байта 0-65535) где h - часы (не более 5), mm- минуты ss-секунды.
    }

    // выполняем второй и последующие циклы записи в память времени и значения давления в память через каждые 5 минут (300000 мс)
    if (millis() - timer3 >= 300000)
    {
        timer3 = millis();
        sens = sensor;
        EEPROM.put(Add1, sens);
        EEPROM.put(Add2, t);
        Add1 = Add1 + 4;
        Add2 = Add2 + 4;
        if (Add1 > 1020)
        {
            Add1 = 0;
        } // при заполнении всех ячеек памяти (1023)цикл записи начнет перезаписывать наиболее старые значения
        if (Add2 > 1022)
        {
            Add2 = 2;
        } // при заполнении всех ячеек памяти (1023)цикл записи начнет перезаписывать наиболее старые значения
    }
}
